// Call with
//   RUN jswitch_wrreg "<address>" "<value>"
//
//   <address>
//     Format:
//       Bit 19..16  BANK number (use 0xF for global register)
//       Bit 11..0   Register address
//
//   <value>    16 bit value to write to register
//
// Examples:
//   RUN jswitch_wrreg "0x1" "0x1"
// => Adds Slave 1 to jtag chain (writes 0x1 to Select Register in Bank 0)
//
//   RUN jswitch_wrreg "0xF0002" "0x1"
// => Turns on Stealth mode
//    Note: A better/more sophisticated implementation
//    to turn on Stealth mode is in "jswitch_stealth.cmm"

PARAMETERS &addr &value

IF SYStem.CONFIG.DEBUGPORTTYPE()!="JTAG"
(
  PRINT %ERROR "JTAG Switcher scripts require debug port type JTAG"
  ENDDO
)

// Lock JTAG for exclusive access
JTAG.LOCK

// make sure we use setting of SYStem.JtagClock
// as JTAG TCK frequency
JTAG.USECLOCK ON

// Go through Test-Logic-Reset to Run-Test/Idle
JTAG.SHIFTTMS 1 1 1 1 1 1 1 1 1 1 0 0 0 0
GOSUB wrReg "&addr" "&value"

IF SYStem.CONFIG.TAPState()==7.
(
  // TRACE32 locks JTAG in Select-DR state.
  // So go from RTI -> SelectDR
  JTAG.SHIFTTMS 1
)

JTAG.UNLOCK

ENDDO


// Address:
//   Bit 19..16   bank
//   Bit 11..0    address
wrReg:
  PARAMETERS &addr &val
  LOCAL &dr
  // DR value:
  //   bit 31..28 bank
  //   bit 27..16 address
  //   bit 15..0  data to write
  &dr=(((&addr)&0xF0000)<<12.)|(((&addr)&0xFFF)<<16.)|((&val)&0xFFFF)

  // RTI -> Shift-IR
  JTAG.SHIFTTMS 1 1 0 0
  // Shift in a lot of '1' bits as IRPRE, to make sure all
  // slave IRs in the chain are loaded with BYPASS
  // Shift in "Set Address + Write to bus" instruction (0xD) last
  JTAG.SHIFTREG %LONG 0xFFFFFFFF 0xFFFFFFFF 0xFFFFFFFF 0xDFFFFFFF
  // Exit1-IR -> Shift-DR
  JTAG.SHIFTTMS 1 0 1 0 0
  // Set Address + Write Value
  JTAG.SHIFTREG %LONG  &dr
  // Exit1-DR -> RTI -> Select-DR
  // Stay 8 cycles in Run-Test/Idle
  // to make sure control register change is activated.
  JTAG.SHIFTTMS 1 0 0 0 0 0 0 0 0
RETURN
